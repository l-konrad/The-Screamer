## nuttx/Kconfig
```kconfig
mainmenu "NuttX project configuration"

config ASSERT
	bool "Build with debug asserts enabled."
	default y

config DEBUG
	bool "Build with debug features enabled"
	depends on !BOOTLOADER
	depends on ASSERT

config FLASH_VERIFY
	bool "Verify the content after flash"
	default n
	---help---
	Verify the content on the storage after flash. Disabling this allows faster
	load time as verify is required only when we expect issues with the flash
	storage.

choice
	prompt "Programmer selection"
	default PROGRAMMER_CMSISDAP

config PROGRAMMER_STLINK
	bool "STLink-v2.1"

config PROGRAMMER_JLINK
	bool "J-Link"

config PROGRAMMER_XDS110
	bool "XDS110"

config PROGRAMMER_CMSISDAP
	bool "CMSIS-DAP"

endchoice

config CROSSDEV
	string "Toolchain prefix"
	default "riscv32-none-elf-"
```

## nuttx/board/configs/defconfig
```kconfig
# Architecture selection
CONFIG_ARCH="risc-v"
CONFIG_ARCH_CHIP="qemu-rv"
CONFIG_ARCH_CHIP_QEMU_RV32=y
CONFIG_ARCH_CHIP_QEMU_RV=y
CONFIG_ARCH_CHIP_QEMU_RV_ISA_A=y
CONFIG_ARCH_CHIP_QEMU_RV_ISA_C=y
CONFIG_ARCH_CHIP_QEMU_RV_ISA_M=y
CONFIG_ARCH_INTERRUPTSTACK=2048
CONFIG_ARCH_RISCV=y
CONFIG_ARCH_STACKDUMP=y
CONFIG_RAM_SIZE=33554432
CONFIG_RAM_START=0x80000000
CONFIG_16550_ADDRWIDTH=0

## Board configuration (feel free to rename your custom name)
CONFIG_ARCH_BOARD_CUSTOM=y
CONFIG_ARCH_BOARD_CUSTOM_DIR="../board"
CONFIG_ARCH_BOARD_CUSTOM_DIR_RELPATH=y
CONFIG_ARCH_BOARD_CUSTOM_NAME="TEMPLATE"

# System options
CONFIG_BOARDCTL_POWEROFF=y
CONFIG_BOARD_LOOPSPERMSEC=6366
CONFIG_ELF=y
CONFIG_IDLETHREAD_STACKSIZE=2048
CONFIG_LIBC_ENVPATH=y
CONFIG_LIBC_EXECFUNCS=y
CONFIG_LIBC_PERROR_STDOUT=y
CONFIG_LIBC_STRERROR=y
CONFIG_LIBM=y
CONFIG_NFILE_DESCRIPTORS_PER_BLOCK=6
CONFIG_RR_INTERVAL=200
CONFIG_SCHED_WAITPID=y
CONFIG_STACK_COLORATION=y
CONFIG_START_MONTH=12
CONFIG_START_YEAR=2021
CONFIG_SYMTAB_ORDEREDBYNAME=y
CONFIG_USEC_PER_TICK=1000

# File-systems
CONFIG_FS_HOSTFS=y
CONFIG_FS_PROCFS=y
CONFIG_RISCV_SEMIHOSTING_HOSTFS=y

# Initial application
CONFIG_INIT_ENTRYPOINT="nsh_main"

# Console
CONFIG_16550_UART0=y
CONFIG_16550_UART0_BASE=0x10000000
CONFIG_16550_UART0_CLOCK=3686400
CONFIG_16550_UART0_IRQ=37
CONFIG_16550_UART0_SERIAL_CONSOLE=y
CONFIG_16550_UART=y
CONFIG_SERIAL_UART_ARCH_MMIO=y

# NSH (NuttX Shell)
CONFIG_BUILTIN=y
CONFIG_NSH_ARCHINIT=y
CONFIG_NSH_BUILTIN_APPS=y
CONFIG_NSH_FILEIOSIZE=512
CONFIG_NSH_READLINE=y
CONFIG_SYSTEM_NSH=y
CONFIG_PATH_INITIAL="/system/bin"
CONFIG_READLINE_CMD_HISTORY=y

CONFIG_EXAMPLES_HELLO=y

CONFIG_TESTING_GETPRIME=y
CONFIG_TESTING_OSTEST=y

# Debug
CONFIG_DEBUG_FEATURES=y
CONFIG_DEBUG_FULLOPT=y
CONFIG_DEBUG_SYMBOLS=y
```

## nuttx/project-apps/meson-apps/Kconfig
```kconfig
#
# For a description of the syntax of this configuration file,
# see the file kconfig-language.txt in the NuttX tools repository.
#

config MESON_APPS
	tristate "Project's Meson applications"
	default y
	---help---
		Applications defined in top level Meson project.

if MESON_APPS

config MESON_APPS_DEFAULT_PRIORITY
	int "Default startup task priority"
	default 100

config MESON_APPS_DEFAULT_STACKSIZE
	int "Default startup stack size"
	default DEFAULT_TASK_STACKSIZE

endif
```
